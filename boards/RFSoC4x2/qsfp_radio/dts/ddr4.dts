/dts-v1/;
/plugin/;
/ {
        /*reserved memory*/
        fragment@1 {
                target-path = "/";
                overlay1: __overlay__ {
                        reserved-memory {
                                ranges;
                                reserved {
                                        reg = <0x04 0x00 0x01 0x00>;
                                };
                        };
                };            
        };
};
